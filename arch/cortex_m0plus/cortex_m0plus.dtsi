/* Architecture Definition: cortex_m0plus */
/ {
    cpus {
        #address-cells = <1>;
        #size-cells = <0>;
        cpu0: cpu@0 {
            device_type = "cpu";
            reg = <0>;
        };
    };
};
